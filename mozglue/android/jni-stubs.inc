/* WARNING - This file is autogenerated by mobile/android/base/jni-generator.py. Do not edit manually! */
#ifdef JNI_STUBS

typedef jboolean (*Java_org_mozilla_goanna_ANRReporter_requestNativeStack_t)(JNIEnv *, jclass, jboolean);
static Java_org_mozilla_goanna_ANRReporter_requestNativeStack_t f_Java_org_mozilla_goanna_ANRReporter_requestNativeStack;
extern "C" NS_EXPORT jboolean JNICALL
Java_org_mozilla_goanna_ANRReporter_requestNativeStack(JNIEnv * arg0, jclass arg1, jboolean arg2) {
    if (!f_Java_org_mozilla_goanna_ANRReporter_requestNativeStack) {
        arg0->ThrowNew(arg0->FindClass("java/lang/UnsupportedOperationException"),
                       "JNI Function called before it was loaded");
        return false;
    }
    return f_Java_org_mozilla_goanna_ANRReporter_requestNativeStack(arg0, arg1, arg2);
}
#endif

#ifdef JNI_BINDINGS
  xul_dlsym("Java_org_mozilla_goanna_ANRReporter_requestNativeStack", &f_Java_org_mozilla_goanna_ANRReporter_requestNativeStack);
#endif

#ifdef JNI_STUBS

typedef jstring (*Java_org_mozilla_goanna_ANRReporter_getNativeStack_t)(JNIEnv *, jclass);
static Java_org_mozilla_goanna_ANRReporter_getNativeStack_t f_Java_org_mozilla_goanna_ANRReporter_getNativeStack;
extern "C" NS_EXPORT jstring JNICALL
Java_org_mozilla_goanna_ANRReporter_getNativeStack(JNIEnv * arg0, jclass arg1) {
    if (!f_Java_org_mozilla_goanna_ANRReporter_getNativeStack) {
        arg0->ThrowNew(arg0->FindClass("java/lang/UnsupportedOperationException"),
                       "JNI Function called before it was loaded");
        return nullptr;
    }
    return f_Java_org_mozilla_goanna_ANRReporter_getNativeStack(arg0, arg1);
}
#endif

#ifdef JNI_BINDINGS
  xul_dlsym("Java_org_mozilla_goanna_ANRReporter_getNativeStack", &f_Java_org_mozilla_goanna_ANRReporter_getNativeStack);
#endif

#ifdef JNI_STUBS

typedef void (*Java_org_mozilla_goanna_ANRReporter_releaseNativeStack_t)(JNIEnv *, jclass);
static Java_org_mozilla_goanna_ANRReporter_releaseNativeStack_t f_Java_org_mozilla_goanna_ANRReporter_releaseNativeStack;
extern "C" NS_EXPORT void JNICALL
Java_org_mozilla_goanna_ANRReporter_releaseNativeStack(JNIEnv * arg0, jclass arg1) {
    if (!f_Java_org_mozilla_goanna_ANRReporter_releaseNativeStack) {
        arg0->ThrowNew(arg0->FindClass("java/lang/UnsupportedOperationException"),
                       "JNI Function called before it was loaded");
        return ;
    }
     f_Java_org_mozilla_goanna_ANRReporter_releaseNativeStack(arg0, arg1);
}
#endif

#ifdef JNI_BINDINGS
  xul_dlsym("Java_org_mozilla_goanna_ANRReporter_releaseNativeStack", &f_Java_org_mozilla_goanna_ANRReporter_releaseNativeStack);
#endif

#ifdef JNI_STUBS

typedef void (*Java_org_mozilla_goanna_GoannaAppShell_registerJavaUiThread_t)(JNIEnv *, jclass);
static Java_org_mozilla_goanna_GoannaAppShell_registerJavaUiThread_t f_Java_org_mozilla_goanna_GoannaAppShell_registerJavaUiThread;
extern "C" NS_EXPORT void JNICALL
Java_org_mozilla_goanna_GoannaAppShell_registerJavaUiThread(JNIEnv * arg0, jclass arg1) {
    if (!f_Java_org_mozilla_goanna_GoannaAppShell_registerJavaUiThread) {
        arg0->ThrowNew(arg0->FindClass("java/lang/UnsupportedOperationException"),
                       "JNI Function called before it was loaded");
        return ;
    }
     f_Java_org_mozilla_goanna_GoannaAppShell_registerJavaUiThread(arg0, arg1);
}
#endif

#ifdef JNI_BINDINGS
  xul_dlsym("Java_org_mozilla_goanna_GoannaAppShell_registerJavaUiThread", &f_Java_org_mozilla_goanna_GoannaAppShell_registerJavaUiThread);
#endif

#ifdef JNI_STUBS

typedef void (*Java_org_mozilla_goanna_GoannaAppShell_nativeInit_t)(JNIEnv *, jclass, jobject);
static Java_org_mozilla_goanna_GoannaAppShell_nativeInit_t f_Java_org_mozilla_goanna_GoannaAppShell_nativeInit;
extern "C" NS_EXPORT void JNICALL
Java_org_mozilla_goanna_GoannaAppShell_nativeInit(JNIEnv * arg0, jclass arg1, jobject arg2) {
    if (!f_Java_org_mozilla_goanna_GoannaAppShell_nativeInit) {
        arg0->ThrowNew(arg0->FindClass("java/lang/UnsupportedOperationException"),
                       "JNI Function called before it was loaded");
        return ;
    }
     f_Java_org_mozilla_goanna_GoannaAppShell_nativeInit(arg0, arg1, arg2);
}
#endif

#ifdef JNI_BINDINGS
  xul_dlsym("Java_org_mozilla_goanna_GoannaAppShell_nativeInit", &f_Java_org_mozilla_goanna_GoannaAppShell_nativeInit);
#endif

#ifdef JNI_STUBS

typedef void (*Java_org_mozilla_goanna_GoannaAppShell_onResume_t)(JNIEnv *, jclass);
static Java_org_mozilla_goanna_GoannaAppShell_onResume_t f_Java_org_mozilla_goanna_GoannaAppShell_onResume;
extern "C" NS_EXPORT void JNICALL
Java_org_mozilla_goanna_GoannaAppShell_onResume(JNIEnv * arg0, jclass arg1) {
    if (!f_Java_org_mozilla_goanna_GoannaAppShell_onResume) {
        arg0->ThrowNew(arg0->FindClass("java/lang/UnsupportedOperationException"),
                       "JNI Function called before it was loaded");
        return ;
    }
     f_Java_org_mozilla_goanna_GoannaAppShell_onResume(arg0, arg1);
}
#endif

#ifdef JNI_BINDINGS
  xul_dlsym("Java_org_mozilla_goanna_GoannaAppShell_onResume", &f_Java_org_mozilla_goanna_GoannaAppShell_onResume);
#endif

#ifdef JNI_STUBS

typedef jobject (*Java_org_mozilla_goanna_GoannaAppShell_getNextMessageFromQueue_t)(JNIEnv *, jclass, jobject);
static Java_org_mozilla_goanna_GoannaAppShell_getNextMessageFromQueue_t f_Java_org_mozilla_goanna_GoannaAppShell_getNextMessageFromQueue;
extern "C" NS_EXPORT jobject JNICALL
Java_org_mozilla_goanna_GoannaAppShell_getNextMessageFromQueue(JNIEnv * arg0, jclass arg1, jobject arg2) {
    if (!f_Java_org_mozilla_goanna_GoannaAppShell_getNextMessageFromQueue) {
        arg0->ThrowNew(arg0->FindClass("java/lang/UnsupportedOperationException"),
                       "JNI Function called before it was loaded");
        return nullptr;
    }
    return f_Java_org_mozilla_goanna_GoannaAppShell_getNextMessageFromQueue(arg0, arg1, arg2);
}
#endif

#ifdef JNI_BINDINGS
  xul_dlsym("Java_org_mozilla_goanna_GoannaAppShell_getNextMessageFromQueue", &f_Java_org_mozilla_goanna_GoannaAppShell_getNextMessageFromQueue);
#endif

#ifdef JNI_STUBS

typedef void (*Java_org_mozilla_goanna_GoannaAppShell_onSurfaceTextureFrameAvailable_t)(JNIEnv *, jclass, jobject, jint);
static Java_org_mozilla_goanna_GoannaAppShell_onSurfaceTextureFrameAvailable_t f_Java_org_mozilla_goanna_GoannaAppShell_onSurfaceTextureFrameAvailable;
extern "C" NS_EXPORT void JNICALL
Java_org_mozilla_goanna_GoannaAppShell_onSurfaceTextureFrameAvailable(JNIEnv * arg0, jclass arg1, jobject arg2, jint arg3) {
    if (!f_Java_org_mozilla_goanna_GoannaAppShell_onSurfaceTextureFrameAvailable) {
        arg0->ThrowNew(arg0->FindClass("java/lang/UnsupportedOperationException"),
                       "JNI Function called before it was loaded");
        return ;
    }
     f_Java_org_mozilla_goanna_GoannaAppShell_onSurfaceTextureFrameAvailable(arg0, arg1, arg2, arg3);
}
#endif

#ifdef JNI_BINDINGS
  xul_dlsym("Java_org_mozilla_goanna_GoannaAppShell_onSurfaceTextureFrameAvailable", &f_Java_org_mozilla_goanna_GoannaAppShell_onSurfaceTextureFrameAvailable);
#endif

#ifdef JNI_STUBS

typedef void (*Java_org_mozilla_goanna_GoannaAppShell_dispatchMemoryPressure_t)(JNIEnv *, jclass);
static Java_org_mozilla_goanna_GoannaAppShell_dispatchMemoryPressure_t f_Java_org_mozilla_goanna_GoannaAppShell_dispatchMemoryPressure;
extern "C" NS_EXPORT void JNICALL
Java_org_mozilla_goanna_GoannaAppShell_dispatchMemoryPressure(JNIEnv * arg0, jclass arg1) {
    if (!f_Java_org_mozilla_goanna_GoannaAppShell_dispatchMemoryPressure) {
        arg0->ThrowNew(arg0->FindClass("java/lang/UnsupportedOperationException"),
                       "JNI Function called before it was loaded");
        return ;
    }
     f_Java_org_mozilla_goanna_GoannaAppShell_dispatchMemoryPressure(arg0, arg1);
}
#endif

#ifdef JNI_BINDINGS
  xul_dlsym("Java_org_mozilla_goanna_GoannaAppShell_dispatchMemoryPressure", &f_Java_org_mozilla_goanna_GoannaAppShell_dispatchMemoryPressure);
#endif

#ifdef JNI_STUBS

typedef void (*Java_org_mozilla_goanna_GoannaAppShell_reportJavaCrash_t)(JNIEnv *, jclass, jstring);
static Java_org_mozilla_goanna_GoannaAppShell_reportJavaCrash_t f_Java_org_mozilla_goanna_GoannaAppShell_reportJavaCrash;
extern "C" NS_EXPORT void JNICALL
Java_org_mozilla_goanna_GoannaAppShell_reportJavaCrash(JNIEnv * arg0, jclass arg1, jstring arg2) {
    if (!f_Java_org_mozilla_goanna_GoannaAppShell_reportJavaCrash) {
        arg0->ThrowNew(arg0->FindClass("java/lang/UnsupportedOperationException"),
                       "JNI Function called before it was loaded");
        return ;
    }
     f_Java_org_mozilla_goanna_GoannaAppShell_reportJavaCrash(arg0, arg1, arg2);
}
#endif

#ifdef JNI_BINDINGS
  xul_dlsym("Java_org_mozilla_goanna_GoannaAppShell_reportJavaCrash", &f_Java_org_mozilla_goanna_GoannaAppShell_reportJavaCrash);
#endif

#ifdef JNI_STUBS

typedef void (*Java_org_mozilla_goanna_GoannaAppShell_processNextNativeEvent_t)(JNIEnv *, jclass, jboolean);
static Java_org_mozilla_goanna_GoannaAppShell_processNextNativeEvent_t f_Java_org_mozilla_goanna_GoannaAppShell_processNextNativeEvent;
extern "C" NS_EXPORT void JNICALL
Java_org_mozilla_goanna_GoannaAppShell_processNextNativeEvent(JNIEnv * arg0, jclass arg1, jboolean arg2) {
    if (!f_Java_org_mozilla_goanna_GoannaAppShell_processNextNativeEvent) {
        arg0->ThrowNew(arg0->FindClass("java/lang/UnsupportedOperationException"),
                       "JNI Function called before it was loaded");
        return ;
    }
     f_Java_org_mozilla_goanna_GoannaAppShell_processNextNativeEvent(arg0, arg1, arg2);
}
#endif

#ifdef JNI_BINDINGS
  xul_dlsym("Java_org_mozilla_goanna_GoannaAppShell_processNextNativeEvent", &f_Java_org_mozilla_goanna_GoannaAppShell_processNextNativeEvent);
#endif

#ifdef JNI_STUBS

typedef void (*Java_org_mozilla_goanna_GoannaAppShell_notifyBatteryChange_t)(JNIEnv *, jclass, jdouble, jboolean, jdouble);
static Java_org_mozilla_goanna_GoannaAppShell_notifyBatteryChange_t f_Java_org_mozilla_goanna_GoannaAppShell_notifyBatteryChange;
extern "C" NS_EXPORT void JNICALL
Java_org_mozilla_goanna_GoannaAppShell_notifyBatteryChange(JNIEnv * arg0, jclass arg1, jdouble arg2, jboolean arg3, jdouble arg4) {
    if (!f_Java_org_mozilla_goanna_GoannaAppShell_notifyBatteryChange) {
        arg0->ThrowNew(arg0->FindClass("java/lang/UnsupportedOperationException"),
                       "JNI Function called before it was loaded");
        return ;
    }
     f_Java_org_mozilla_goanna_GoannaAppShell_notifyBatteryChange(arg0, arg1, arg2, arg3, arg4);
}
#endif

#ifdef JNI_BINDINGS
  xul_dlsym("Java_org_mozilla_goanna_GoannaAppShell_notifyBatteryChange", &f_Java_org_mozilla_goanna_GoannaAppShell_notifyBatteryChange);
#endif

#ifdef JNI_STUBS

typedef void (*Java_org_mozilla_goanna_GoannaAppShell_scheduleComposite_t)(JNIEnv *, jclass);
static Java_org_mozilla_goanna_GoannaAppShell_scheduleComposite_t f_Java_org_mozilla_goanna_GoannaAppShell_scheduleComposite;
extern "C" NS_EXPORT void JNICALL
Java_org_mozilla_goanna_GoannaAppShell_scheduleComposite(JNIEnv * arg0, jclass arg1) {
    if (!f_Java_org_mozilla_goanna_GoannaAppShell_scheduleComposite) {
        arg0->ThrowNew(arg0->FindClass("java/lang/UnsupportedOperationException"),
                       "JNI Function called before it was loaded");
        return ;
    }
     f_Java_org_mozilla_goanna_GoannaAppShell_scheduleComposite(arg0, arg1);
}
#endif

#ifdef JNI_BINDINGS
  xul_dlsym("Java_org_mozilla_goanna_GoannaAppShell_scheduleComposite", &f_Java_org_mozilla_goanna_GoannaAppShell_scheduleComposite);
#endif

#ifdef JNI_STUBS

typedef void (*Java_org_mozilla_goanna_GoannaAppShell_scheduleResumeComposition_t)(JNIEnv *, jclass, jint, jint);
static Java_org_mozilla_goanna_GoannaAppShell_scheduleResumeComposition_t f_Java_org_mozilla_goanna_GoannaAppShell_scheduleResumeComposition;
extern "C" NS_EXPORT void JNICALL
Java_org_mozilla_goanna_GoannaAppShell_scheduleResumeComposition(JNIEnv * arg0, jclass arg1, jint arg2, jint arg3) {
    if (!f_Java_org_mozilla_goanna_GoannaAppShell_scheduleResumeComposition) {
        arg0->ThrowNew(arg0->FindClass("java/lang/UnsupportedOperationException"),
                       "JNI Function called before it was loaded");
        return ;
    }
     f_Java_org_mozilla_goanna_GoannaAppShell_scheduleResumeComposition(arg0, arg1, arg2, arg3);
}
#endif

#ifdef JNI_BINDINGS
  xul_dlsym("Java_org_mozilla_goanna_GoannaAppShell_scheduleResumeComposition", &f_Java_org_mozilla_goanna_GoannaAppShell_scheduleResumeComposition);
#endif

#ifdef JNI_STUBS

typedef jfloat (*Java_org_mozilla_goanna_GoannaAppShell_computeRenderIntegrity_t)(JNIEnv *, jclass);
static Java_org_mozilla_goanna_GoannaAppShell_computeRenderIntegrity_t f_Java_org_mozilla_goanna_GoannaAppShell_computeRenderIntegrity;
extern "C" NS_EXPORT jfloat JNICALL
Java_org_mozilla_goanna_GoannaAppShell_computeRenderIntegrity(JNIEnv * arg0, jclass arg1) {
    if (!f_Java_org_mozilla_goanna_GoannaAppShell_computeRenderIntegrity) {
        arg0->ThrowNew(arg0->FindClass("java/lang/UnsupportedOperationException"),
                       "JNI Function called before it was loaded");
        return 0;
    }
    return f_Java_org_mozilla_goanna_GoannaAppShell_computeRenderIntegrity(arg0, arg1);
}
#endif

#ifdef JNI_BINDINGS
  xul_dlsym("Java_org_mozilla_goanna_GoannaAppShell_computeRenderIntegrity", &f_Java_org_mozilla_goanna_GoannaAppShell_computeRenderIntegrity);
#endif

#ifdef JNI_STUBS

typedef jobject (*Java_org_mozilla_goanna_GoannaAppShell_getSurfaceBits_t)(JNIEnv *, jclass, jobject);
static Java_org_mozilla_goanna_GoannaAppShell_getSurfaceBits_t f_Java_org_mozilla_goanna_GoannaAppShell_getSurfaceBits;
extern "C" NS_EXPORT jobject JNICALL
Java_org_mozilla_goanna_GoannaAppShell_getSurfaceBits(JNIEnv * arg0, jclass arg1, jobject arg2) {
    if (!f_Java_org_mozilla_goanna_GoannaAppShell_getSurfaceBits) {
        arg0->ThrowNew(arg0->FindClass("java/lang/UnsupportedOperationException"),
                       "JNI Function called before it was loaded");
        return nullptr;
    }
    return f_Java_org_mozilla_goanna_GoannaAppShell_getSurfaceBits(arg0, arg1, arg2);
}
#endif

#ifdef JNI_BINDINGS
  xul_dlsym("Java_org_mozilla_goanna_GoannaAppShell_getSurfaceBits", &f_Java_org_mozilla_goanna_GoannaAppShell_getSurfaceBits);
#endif

#ifdef JNI_STUBS

typedef void (*Java_org_mozilla_goanna_GoannaAppShell_onFullScreenPluginHidden_t)(JNIEnv *, jclass, jobject);
static Java_org_mozilla_goanna_GoannaAppShell_onFullScreenPluginHidden_t f_Java_org_mozilla_goanna_GoannaAppShell_onFullScreenPluginHidden;
extern "C" NS_EXPORT void JNICALL
Java_org_mozilla_goanna_GoannaAppShell_onFullScreenPluginHidden(JNIEnv * arg0, jclass arg1, jobject arg2) {
    if (!f_Java_org_mozilla_goanna_GoannaAppShell_onFullScreenPluginHidden) {
        arg0->ThrowNew(arg0->FindClass("java/lang/UnsupportedOperationException"),
                       "JNI Function called before it was loaded");
        return ;
    }
     f_Java_org_mozilla_goanna_GoannaAppShell_onFullScreenPluginHidden(arg0, arg1, arg2);
}
#endif

#ifdef JNI_BINDINGS
  xul_dlsym("Java_org_mozilla_goanna_GoannaAppShell_onFullScreenPluginHidden", &f_Java_org_mozilla_goanna_GoannaAppShell_onFullScreenPluginHidden);
#endif

#ifdef JNI_STUBS

typedef void (*Java_org_mozilla_goanna_GoannaAppShell_notifyGoannaOfEvent_t)(JNIEnv *, jclass, jobject);
static Java_org_mozilla_goanna_GoannaAppShell_notifyGoannaOfEvent_t f_Java_org_mozilla_goanna_GoannaAppShell_notifyGoannaOfEvent;
extern "C" NS_EXPORT void JNICALL
Java_org_mozilla_goanna_GoannaAppShell_notifyGoannaOfEvent(JNIEnv * arg0, jclass arg1, jobject arg2) {
    if (!f_Java_org_mozilla_goanna_GoannaAppShell_notifyGoannaOfEvent) {
        arg0->ThrowNew(arg0->FindClass("java/lang/UnsupportedOperationException"),
                       "JNI Function called before it was loaded");
        return ;
    }
     f_Java_org_mozilla_goanna_GoannaAppShell_notifyGoannaOfEvent(arg0, arg1, arg2);
}
#endif

#ifdef JNI_BINDINGS
  xul_dlsym("Java_org_mozilla_goanna_GoannaAppShell_notifyGoannaOfEvent", &f_Java_org_mozilla_goanna_GoannaAppShell_notifyGoannaOfEvent);
#endif

#ifdef JNI_STUBS

typedef void (*Java_org_mozilla_goanna_GoannaAppShell_notifyGoannaObservers_t)(JNIEnv *, jclass, jstring, jstring);
static Java_org_mozilla_goanna_GoannaAppShell_notifyGoannaObservers_t f_Java_org_mozilla_goanna_GoannaAppShell_notifyGoannaObservers;
extern "C" NS_EXPORT void JNICALL
Java_org_mozilla_goanna_GoannaAppShell_notifyGoannaObservers(JNIEnv * arg0, jclass arg1, jstring arg2, jstring arg3) {
    if (!f_Java_org_mozilla_goanna_GoannaAppShell_notifyGoannaObservers) {
        arg0->ThrowNew(arg0->FindClass("java/lang/UnsupportedOperationException"),
                       "JNI Function called before it was loaded");
        return ;
    }
     f_Java_org_mozilla_goanna_GoannaAppShell_notifyGoannaObservers(arg0, arg1, arg2, arg3);
}
#endif

#ifdef JNI_BINDINGS
  xul_dlsym("Java_org_mozilla_goanna_GoannaAppShell_notifyGoannaObservers", &f_Java_org_mozilla_goanna_GoannaAppShell_notifyGoannaObservers);
#endif

#ifdef JNI_STUBS

typedef jlong (*Java_org_mozilla_goanna_GoannaAppShell_runUiThreadCallback_t)(JNIEnv *, jclass);
static Java_org_mozilla_goanna_GoannaAppShell_runUiThreadCallback_t f_Java_org_mozilla_goanna_GoannaAppShell_runUiThreadCallback;
extern "C" NS_EXPORT jlong JNICALL
Java_org_mozilla_goanna_GoannaAppShell_runUiThreadCallback(JNIEnv * arg0, jclass arg1) {
    if (!f_Java_org_mozilla_goanna_GoannaAppShell_runUiThreadCallback) {
        arg0->ThrowNew(arg0->FindClass("java/lang/UnsupportedOperationException"),
                       "JNI Function called before it was loaded");
        return 0;
    }
    return f_Java_org_mozilla_goanna_GoannaAppShell_runUiThreadCallback(arg0, arg1);
}
#endif

#ifdef JNI_BINDINGS
  xul_dlsym("Java_org_mozilla_goanna_GoannaAppShell_runUiThreadCallback", &f_Java_org_mozilla_goanna_GoannaAppShell_runUiThreadCallback);
#endif

#ifdef JNI_STUBS

typedef void (*Java_org_mozilla_goanna_GoannaAppShell_cameraCallbackBridge_t)(JNIEnv *, jclass, jbyteArray);
static Java_org_mozilla_goanna_GoannaAppShell_cameraCallbackBridge_t f_Java_org_mozilla_goanna_GoannaAppShell_cameraCallbackBridge;
extern "C" NS_EXPORT void JNICALL
Java_org_mozilla_goanna_GoannaAppShell_cameraCallbackBridge(JNIEnv * arg0, jclass arg1, jbyteArray arg2) {
    if (!f_Java_org_mozilla_goanna_GoannaAppShell_cameraCallbackBridge) {
        arg0->ThrowNew(arg0->FindClass("java/lang/UnsupportedOperationException"),
                       "JNI Function called before it was loaded");
        return ;
    }
     f_Java_org_mozilla_goanna_GoannaAppShell_cameraCallbackBridge(arg0, arg1, arg2);
}
#endif

#ifdef JNI_BINDINGS
  xul_dlsym("Java_org_mozilla_goanna_GoannaAppShell_cameraCallbackBridge", &f_Java_org_mozilla_goanna_GoannaAppShell_cameraCallbackBridge);
#endif

#ifdef JNI_STUBS

typedef jdouble (*Java_org_mozilla_goanna_GoannaJavaSampler_getProfilerTime_t)(JNIEnv *, jclass);
static Java_org_mozilla_goanna_GoannaJavaSampler_getProfilerTime_t f_Java_org_mozilla_goanna_GoannaJavaSampler_getProfilerTime;
extern "C" NS_EXPORT jdouble JNICALL
Java_org_mozilla_goanna_GoannaJavaSampler_getProfilerTime(JNIEnv * arg0, jclass arg1) {
    if (!f_Java_org_mozilla_goanna_GoannaJavaSampler_getProfilerTime) {
        arg0->ThrowNew(arg0->FindClass("java/lang/UnsupportedOperationException"),
                       "JNI Function called before it was loaded");
        return 0;
    }
    return f_Java_org_mozilla_goanna_GoannaJavaSampler_getProfilerTime(arg0, arg1);
}
#endif

#ifdef JNI_BINDINGS
  xul_dlsym("Java_org_mozilla_goanna_GoannaJavaSampler_getProfilerTime", &f_Java_org_mozilla_goanna_GoannaJavaSampler_getProfilerTime);
#endif

#ifdef JNI_STUBS

typedef void (*Java_org_mozilla_goanna_gfx_NativePanZoomController_abortAnimation_t)(JNIEnv *, jobject);
static Java_org_mozilla_goanna_gfx_NativePanZoomController_abortAnimation_t f_Java_org_mozilla_goanna_gfx_NativePanZoomController_abortAnimation;
extern "C" NS_EXPORT void JNICALL
Java_org_mozilla_goanna_gfx_NativePanZoomController_abortAnimation(JNIEnv * arg0, jobject arg1) {
    if (!f_Java_org_mozilla_goanna_gfx_NativePanZoomController_abortAnimation) {
        arg0->ThrowNew(arg0->FindClass("java/lang/UnsupportedOperationException"),
                       "JNI Function called before it was loaded");
        return ;
    }
     f_Java_org_mozilla_goanna_gfx_NativePanZoomController_abortAnimation(arg0, arg1);
}
#endif

#ifdef JNI_BINDINGS
  xul_dlsym("Java_org_mozilla_goanna_gfx_NativePanZoomController_abortAnimation", &f_Java_org_mozilla_goanna_gfx_NativePanZoomController_abortAnimation);
#endif

#ifdef JNI_STUBS

typedef void (*Java_org_mozilla_goanna_gfx_NativePanZoomController_init_t)(JNIEnv *, jobject);
static Java_org_mozilla_goanna_gfx_NativePanZoomController_init_t f_Java_org_mozilla_goanna_gfx_NativePanZoomController_init;
extern "C" NS_EXPORT void JNICALL
Java_org_mozilla_goanna_gfx_NativePanZoomController_init(JNIEnv * arg0, jobject arg1) {
    if (!f_Java_org_mozilla_goanna_gfx_NativePanZoomController_init) {
        arg0->ThrowNew(arg0->FindClass("java/lang/UnsupportedOperationException"),
                       "JNI Function called before it was loaded");
        return ;
    }
     f_Java_org_mozilla_goanna_gfx_NativePanZoomController_init(arg0, arg1);
}
#endif

#ifdef JNI_BINDINGS
  xul_dlsym("Java_org_mozilla_goanna_gfx_NativePanZoomController_init", &f_Java_org_mozilla_goanna_gfx_NativePanZoomController_init);
#endif

#ifdef JNI_STUBS

typedef jboolean (*Java_org_mozilla_goanna_gfx_NativePanZoomController_handleTouchEvent_t)(JNIEnv *, jobject, jobject);
static Java_org_mozilla_goanna_gfx_NativePanZoomController_handleTouchEvent_t f_Java_org_mozilla_goanna_gfx_NativePanZoomController_handleTouchEvent;
extern "C" NS_EXPORT jboolean JNICALL
Java_org_mozilla_goanna_gfx_NativePanZoomController_handleTouchEvent(JNIEnv * arg0, jobject arg1, jobject arg2) {
    if (!f_Java_org_mozilla_goanna_gfx_NativePanZoomController_handleTouchEvent) {
        arg0->ThrowNew(arg0->FindClass("java/lang/UnsupportedOperationException"),
                       "JNI Function called before it was loaded");
        return false;
    }
    return f_Java_org_mozilla_goanna_gfx_NativePanZoomController_handleTouchEvent(arg0, arg1, arg2);
}
#endif

#ifdef JNI_BINDINGS
  xul_dlsym("Java_org_mozilla_goanna_gfx_NativePanZoomController_handleTouchEvent", &f_Java_org_mozilla_goanna_gfx_NativePanZoomController_handleTouchEvent);
#endif

#ifdef JNI_STUBS

typedef void (*Java_org_mozilla_goanna_gfx_NativePanZoomController_handleMotionEvent_t)(JNIEnv *, jobject, jobject);
static Java_org_mozilla_goanna_gfx_NativePanZoomController_handleMotionEvent_t f_Java_org_mozilla_goanna_gfx_NativePanZoomController_handleMotionEvent;
extern "C" NS_EXPORT void JNICALL
Java_org_mozilla_goanna_gfx_NativePanZoomController_handleMotionEvent(JNIEnv * arg0, jobject arg1, jobject arg2) {
    if (!f_Java_org_mozilla_goanna_gfx_NativePanZoomController_handleMotionEvent) {
        arg0->ThrowNew(arg0->FindClass("java/lang/UnsupportedOperationException"),
                       "JNI Function called before it was loaded");
        return ;
    }
     f_Java_org_mozilla_goanna_gfx_NativePanZoomController_handleMotionEvent(arg0, arg1, arg2);
}
#endif

#ifdef JNI_BINDINGS
  xul_dlsym("Java_org_mozilla_goanna_gfx_NativePanZoomController_handleMotionEvent", &f_Java_org_mozilla_goanna_gfx_NativePanZoomController_handleMotionEvent);
#endif

#ifdef JNI_STUBS

typedef void (*Java_org_mozilla_goanna_gfx_NativePanZoomController_destroy_t)(JNIEnv *, jobject);
static Java_org_mozilla_goanna_gfx_NativePanZoomController_destroy_t f_Java_org_mozilla_goanna_gfx_NativePanZoomController_destroy;
extern "C" NS_EXPORT void JNICALL
Java_org_mozilla_goanna_gfx_NativePanZoomController_destroy(JNIEnv * arg0, jobject arg1) {
    if (!f_Java_org_mozilla_goanna_gfx_NativePanZoomController_destroy) {
        arg0->ThrowNew(arg0->FindClass("java/lang/UnsupportedOperationException"),
                       "JNI Function called before it was loaded");
        return ;
    }
     f_Java_org_mozilla_goanna_gfx_NativePanZoomController_destroy(arg0, arg1);
}
#endif

#ifdef JNI_BINDINGS
  xul_dlsym("Java_org_mozilla_goanna_gfx_NativePanZoomController_destroy", &f_Java_org_mozilla_goanna_gfx_NativePanZoomController_destroy);
#endif

#ifdef JNI_STUBS

typedef jboolean (*Java_org_mozilla_goanna_gfx_NativePanZoomController_getRedrawHint_t)(JNIEnv *, jobject);
static Java_org_mozilla_goanna_gfx_NativePanZoomController_getRedrawHint_t f_Java_org_mozilla_goanna_gfx_NativePanZoomController_getRedrawHint;
extern "C" NS_EXPORT jboolean JNICALL
Java_org_mozilla_goanna_gfx_NativePanZoomController_getRedrawHint(JNIEnv * arg0, jobject arg1) {
    if (!f_Java_org_mozilla_goanna_gfx_NativePanZoomController_getRedrawHint) {
        arg0->ThrowNew(arg0->FindClass("java/lang/UnsupportedOperationException"),
                       "JNI Function called before it was loaded");
        return false;
    }
    return f_Java_org_mozilla_goanna_gfx_NativePanZoomController_getRedrawHint(arg0, arg1);
}
#endif

#ifdef JNI_BINDINGS
  xul_dlsym("Java_org_mozilla_goanna_gfx_NativePanZoomController_getRedrawHint", &f_Java_org_mozilla_goanna_gfx_NativePanZoomController_getRedrawHint);
#endif

#ifdef JNI_STUBS

typedef void (*Java_org_mozilla_goanna_gfx_NativePanZoomController_setOverScrollMode_t)(JNIEnv *, jobject, jint);
static Java_org_mozilla_goanna_gfx_NativePanZoomController_setOverScrollMode_t f_Java_org_mozilla_goanna_gfx_NativePanZoomController_setOverScrollMode;
extern "C" NS_EXPORT void JNICALL
Java_org_mozilla_goanna_gfx_NativePanZoomController_setOverScrollMode(JNIEnv * arg0, jobject arg1, jint arg2) {
    if (!f_Java_org_mozilla_goanna_gfx_NativePanZoomController_setOverScrollMode) {
        arg0->ThrowNew(arg0->FindClass("java/lang/UnsupportedOperationException"),
                       "JNI Function called before it was loaded");
        return ;
    }
     f_Java_org_mozilla_goanna_gfx_NativePanZoomController_setOverScrollMode(arg0, arg1, arg2);
}
#endif

#ifdef JNI_BINDINGS
  xul_dlsym("Java_org_mozilla_goanna_gfx_NativePanZoomController_setOverScrollMode", &f_Java_org_mozilla_goanna_gfx_NativePanZoomController_setOverScrollMode);
#endif

#ifdef JNI_STUBS

typedef jint (*Java_org_mozilla_goanna_gfx_NativePanZoomController_getOverScrollMode_t)(JNIEnv *, jobject);
static Java_org_mozilla_goanna_gfx_NativePanZoomController_getOverScrollMode_t f_Java_org_mozilla_goanna_gfx_NativePanZoomController_getOverScrollMode;
extern "C" NS_EXPORT jint JNICALL
Java_org_mozilla_goanna_gfx_NativePanZoomController_getOverScrollMode(JNIEnv * arg0, jobject arg1) {
    if (!f_Java_org_mozilla_goanna_gfx_NativePanZoomController_getOverScrollMode) {
        arg0->ThrowNew(arg0->FindClass("java/lang/UnsupportedOperationException"),
                       "JNI Function called before it was loaded");
        return 0;
    }
    return f_Java_org_mozilla_goanna_gfx_NativePanZoomController_getOverScrollMode(arg0, arg1);
}
#endif

#ifdef JNI_BINDINGS
  xul_dlsym("Java_org_mozilla_goanna_gfx_NativePanZoomController_getOverScrollMode", &f_Java_org_mozilla_goanna_gfx_NativePanZoomController_getOverScrollMode);
#endif

#ifdef JNI_STUBS

typedef jobject (*Java_org_mozilla_goanna_util_NativeJSContainer_clone_t)(JNIEnv *, jobject);
static Java_org_mozilla_goanna_util_NativeJSContainer_clone_t f_Java_org_mozilla_goanna_util_NativeJSContainer_clone;
extern "C" NS_EXPORT jobject JNICALL
Java_org_mozilla_goanna_util_NativeJSContainer_clone(JNIEnv * arg0, jobject arg1) {
    if (!f_Java_org_mozilla_goanna_util_NativeJSContainer_clone) {
        arg0->ThrowNew(arg0->FindClass("java/lang/UnsupportedOperationException"),
                       "JNI Function called before it was loaded");
        return nullptr;
    }
    return f_Java_org_mozilla_goanna_util_NativeJSContainer_clone(arg0, arg1);
}
#endif

#ifdef JNI_BINDINGS
  xul_dlsym("Java_org_mozilla_goanna_util_NativeJSContainer_clone", &f_Java_org_mozilla_goanna_util_NativeJSContainer_clone);
#endif

#ifdef JNI_STUBS

typedef void (*Java_org_mozilla_goanna_util_NativeJSContainer_dispose_t)(JNIEnv *, jobject);
static Java_org_mozilla_goanna_util_NativeJSContainer_dispose_t f_Java_org_mozilla_goanna_util_NativeJSContainer_dispose;
extern "C" NS_EXPORT void JNICALL
Java_org_mozilla_goanna_util_NativeJSContainer_dispose(JNIEnv * arg0, jobject arg1) {
    if (!f_Java_org_mozilla_goanna_util_NativeJSContainer_dispose) {
        arg0->ThrowNew(arg0->FindClass("java/lang/UnsupportedOperationException"),
                       "JNI Function called before it was loaded");
        return ;
    }
     f_Java_org_mozilla_goanna_util_NativeJSContainer_dispose(arg0, arg1);
}
#endif

#ifdef JNI_BINDINGS
  xul_dlsym("Java_org_mozilla_goanna_util_NativeJSContainer_dispose", &f_Java_org_mozilla_goanna_util_NativeJSContainer_dispose);
#endif

#ifdef JNI_STUBS

typedef jboolean (*Java_org_mozilla_goanna_util_NativeJSObject_getBoolean_t)(JNIEnv *, jobject, jstring);
static Java_org_mozilla_goanna_util_NativeJSObject_getBoolean_t f_Java_org_mozilla_goanna_util_NativeJSObject_getBoolean;
extern "C" NS_EXPORT jboolean JNICALL
Java_org_mozilla_goanna_util_NativeJSObject_getBoolean(JNIEnv * arg0, jobject arg1, jstring arg2) {
    if (!f_Java_org_mozilla_goanna_util_NativeJSObject_getBoolean) {
        arg0->ThrowNew(arg0->FindClass("java/lang/UnsupportedOperationException"),
                       "JNI Function called before it was loaded");
        return false;
    }
    return f_Java_org_mozilla_goanna_util_NativeJSObject_getBoolean(arg0, arg1, arg2);
}
#endif

#ifdef JNI_BINDINGS
  xul_dlsym("Java_org_mozilla_goanna_util_NativeJSObject_getBoolean", &f_Java_org_mozilla_goanna_util_NativeJSObject_getBoolean);
#endif

#ifdef JNI_STUBS

typedef jboolean (*Java_org_mozilla_goanna_util_NativeJSObject_optBoolean_t)(JNIEnv *, jobject, jstring, jboolean);
static Java_org_mozilla_goanna_util_NativeJSObject_optBoolean_t f_Java_org_mozilla_goanna_util_NativeJSObject_optBoolean;
extern "C" NS_EXPORT jboolean JNICALL
Java_org_mozilla_goanna_util_NativeJSObject_optBoolean(JNIEnv * arg0, jobject arg1, jstring arg2, jboolean arg3) {
    if (!f_Java_org_mozilla_goanna_util_NativeJSObject_optBoolean) {
        arg0->ThrowNew(arg0->FindClass("java/lang/UnsupportedOperationException"),
                       "JNI Function called before it was loaded");
        return false;
    }
    return f_Java_org_mozilla_goanna_util_NativeJSObject_optBoolean(arg0, arg1, arg2, arg3);
}
#endif

#ifdef JNI_BINDINGS
  xul_dlsym("Java_org_mozilla_goanna_util_NativeJSObject_optBoolean", &f_Java_org_mozilla_goanna_util_NativeJSObject_optBoolean);
#endif

#ifdef JNI_STUBS

typedef jbooleanArray (*Java_org_mozilla_goanna_util_NativeJSObject_getBooleanArray_t)(JNIEnv *, jobject, jstring);
static Java_org_mozilla_goanna_util_NativeJSObject_getBooleanArray_t f_Java_org_mozilla_goanna_util_NativeJSObject_getBooleanArray;
extern "C" NS_EXPORT jbooleanArray JNICALL
Java_org_mozilla_goanna_util_NativeJSObject_getBooleanArray(JNIEnv * arg0, jobject arg1, jstring arg2) {
    if (!f_Java_org_mozilla_goanna_util_NativeJSObject_getBooleanArray) {
        arg0->ThrowNew(arg0->FindClass("java/lang/UnsupportedOperationException"),
                       "JNI Function called before it was loaded");
        return nullptr;
    }
    return f_Java_org_mozilla_goanna_util_NativeJSObject_getBooleanArray(arg0, arg1, arg2);
}
#endif

#ifdef JNI_BINDINGS
  xul_dlsym("Java_org_mozilla_goanna_util_NativeJSObject_getBooleanArray", &f_Java_org_mozilla_goanna_util_NativeJSObject_getBooleanArray);
#endif

#ifdef JNI_STUBS

typedef jbooleanArray (*Java_org_mozilla_goanna_util_NativeJSObject_optBooleanArray_t)(JNIEnv *, jobject, jstring, jbooleanArray);
static Java_org_mozilla_goanna_util_NativeJSObject_optBooleanArray_t f_Java_org_mozilla_goanna_util_NativeJSObject_optBooleanArray;
extern "C" NS_EXPORT jbooleanArray JNICALL
Java_org_mozilla_goanna_util_NativeJSObject_optBooleanArray(JNIEnv * arg0, jobject arg1, jstring arg2, jbooleanArray arg3) {
    if (!f_Java_org_mozilla_goanna_util_NativeJSObject_optBooleanArray) {
        arg0->ThrowNew(arg0->FindClass("java/lang/UnsupportedOperationException"),
                       "JNI Function called before it was loaded");
        return nullptr;
    }
    return f_Java_org_mozilla_goanna_util_NativeJSObject_optBooleanArray(arg0, arg1, arg2, arg3);
}
#endif

#ifdef JNI_BINDINGS
  xul_dlsym("Java_org_mozilla_goanna_util_NativeJSObject_optBooleanArray", &f_Java_org_mozilla_goanna_util_NativeJSObject_optBooleanArray);
#endif

#ifdef JNI_STUBS

typedef jobject (*Java_org_mozilla_goanna_util_NativeJSObject_getBundle_t)(JNIEnv *, jobject, jstring);
static Java_org_mozilla_goanna_util_NativeJSObject_getBundle_t f_Java_org_mozilla_goanna_util_NativeJSObject_getBundle;
extern "C" NS_EXPORT jobject JNICALL
Java_org_mozilla_goanna_util_NativeJSObject_getBundle(JNIEnv * arg0, jobject arg1, jstring arg2) {
    if (!f_Java_org_mozilla_goanna_util_NativeJSObject_getBundle) {
        arg0->ThrowNew(arg0->FindClass("java/lang/UnsupportedOperationException"),
                       "JNI Function called before it was loaded");
        return nullptr;
    }
    return f_Java_org_mozilla_goanna_util_NativeJSObject_getBundle(arg0, arg1, arg2);
}
#endif

#ifdef JNI_BINDINGS
  xul_dlsym("Java_org_mozilla_goanna_util_NativeJSObject_getBundle", &f_Java_org_mozilla_goanna_util_NativeJSObject_getBundle);
#endif

#ifdef JNI_STUBS

typedef jobject (*Java_org_mozilla_goanna_util_NativeJSObject_optBundle_t)(JNIEnv *, jobject, jstring, jobject);
static Java_org_mozilla_goanna_util_NativeJSObject_optBundle_t f_Java_org_mozilla_goanna_util_NativeJSObject_optBundle;
extern "C" NS_EXPORT jobject JNICALL
Java_org_mozilla_goanna_util_NativeJSObject_optBundle(JNIEnv * arg0, jobject arg1, jstring arg2, jobject arg3) {
    if (!f_Java_org_mozilla_goanna_util_NativeJSObject_optBundle) {
        arg0->ThrowNew(arg0->FindClass("java/lang/UnsupportedOperationException"),
                       "JNI Function called before it was loaded");
        return nullptr;
    }
    return f_Java_org_mozilla_goanna_util_NativeJSObject_optBundle(arg0, arg1, arg2, arg3);
}
#endif

#ifdef JNI_BINDINGS
  xul_dlsym("Java_org_mozilla_goanna_util_NativeJSObject_optBundle", &f_Java_org_mozilla_goanna_util_NativeJSObject_optBundle);
#endif

#ifdef JNI_STUBS

typedef jobjectArray (*Java_org_mozilla_goanna_util_NativeJSObject_getBundleArray_t)(JNIEnv *, jobject, jstring);
static Java_org_mozilla_goanna_util_NativeJSObject_getBundleArray_t f_Java_org_mozilla_goanna_util_NativeJSObject_getBundleArray;
extern "C" NS_EXPORT jobjectArray JNICALL
Java_org_mozilla_goanna_util_NativeJSObject_getBundleArray(JNIEnv * arg0, jobject arg1, jstring arg2) {
    if (!f_Java_org_mozilla_goanna_util_NativeJSObject_getBundleArray) {
        arg0->ThrowNew(arg0->FindClass("java/lang/UnsupportedOperationException"),
                       "JNI Function called before it was loaded");
        return nullptr;
    }
    return f_Java_org_mozilla_goanna_util_NativeJSObject_getBundleArray(arg0, arg1, arg2);
}
#endif

#ifdef JNI_BINDINGS
  xul_dlsym("Java_org_mozilla_goanna_util_NativeJSObject_getBundleArray", &f_Java_org_mozilla_goanna_util_NativeJSObject_getBundleArray);
#endif

#ifdef JNI_STUBS

typedef jobjectArray (*Java_org_mozilla_goanna_util_NativeJSObject_optBundleArray_t)(JNIEnv *, jobject, jstring, jobjectArray);
static Java_org_mozilla_goanna_util_NativeJSObject_optBundleArray_t f_Java_org_mozilla_goanna_util_NativeJSObject_optBundleArray;
extern "C" NS_EXPORT jobjectArray JNICALL
Java_org_mozilla_goanna_util_NativeJSObject_optBundleArray(JNIEnv * arg0, jobject arg1, jstring arg2, jobjectArray arg3) {
    if (!f_Java_org_mozilla_goanna_util_NativeJSObject_optBundleArray) {
        arg0->ThrowNew(arg0->FindClass("java/lang/UnsupportedOperationException"),
                       "JNI Function called before it was loaded");
        return nullptr;
    }
    return f_Java_org_mozilla_goanna_util_NativeJSObject_optBundleArray(arg0, arg1, arg2, arg3);
}
#endif

#ifdef JNI_BINDINGS
  xul_dlsym("Java_org_mozilla_goanna_util_NativeJSObject_optBundleArray", &f_Java_org_mozilla_goanna_util_NativeJSObject_optBundleArray);
#endif

#ifdef JNI_STUBS

typedef jdouble (*Java_org_mozilla_goanna_util_NativeJSObject_getDouble_t)(JNIEnv *, jobject, jstring);
static Java_org_mozilla_goanna_util_NativeJSObject_getDouble_t f_Java_org_mozilla_goanna_util_NativeJSObject_getDouble;
extern "C" NS_EXPORT jdouble JNICALL
Java_org_mozilla_goanna_util_NativeJSObject_getDouble(JNIEnv * arg0, jobject arg1, jstring arg2) {
    if (!f_Java_org_mozilla_goanna_util_NativeJSObject_getDouble) {
        arg0->ThrowNew(arg0->FindClass("java/lang/UnsupportedOperationException"),
                       "JNI Function called before it was loaded");
        return 0;
    }
    return f_Java_org_mozilla_goanna_util_NativeJSObject_getDouble(arg0, arg1, arg2);
}
#endif

#ifdef JNI_BINDINGS
  xul_dlsym("Java_org_mozilla_goanna_util_NativeJSObject_getDouble", &f_Java_org_mozilla_goanna_util_NativeJSObject_getDouble);
#endif

#ifdef JNI_STUBS

typedef jdouble (*Java_org_mozilla_goanna_util_NativeJSObject_optDouble_t)(JNIEnv *, jobject, jstring, jdouble);
static Java_org_mozilla_goanna_util_NativeJSObject_optDouble_t f_Java_org_mozilla_goanna_util_NativeJSObject_optDouble;
extern "C" NS_EXPORT jdouble JNICALL
Java_org_mozilla_goanna_util_NativeJSObject_optDouble(JNIEnv * arg0, jobject arg1, jstring arg2, jdouble arg3) {
    if (!f_Java_org_mozilla_goanna_util_NativeJSObject_optDouble) {
        arg0->ThrowNew(arg0->FindClass("java/lang/UnsupportedOperationException"),
                       "JNI Function called before it was loaded");
        return 0;
    }
    return f_Java_org_mozilla_goanna_util_NativeJSObject_optDouble(arg0, arg1, arg2, arg3);
}
#endif

#ifdef JNI_BINDINGS
  xul_dlsym("Java_org_mozilla_goanna_util_NativeJSObject_optDouble", &f_Java_org_mozilla_goanna_util_NativeJSObject_optDouble);
#endif

#ifdef JNI_STUBS

typedef jdoubleArray (*Java_org_mozilla_goanna_util_NativeJSObject_getDoubleArray_t)(JNIEnv *, jobject, jstring);
static Java_org_mozilla_goanna_util_NativeJSObject_getDoubleArray_t f_Java_org_mozilla_goanna_util_NativeJSObject_getDoubleArray;
extern "C" NS_EXPORT jdoubleArray JNICALL
Java_org_mozilla_goanna_util_NativeJSObject_getDoubleArray(JNIEnv * arg0, jobject arg1, jstring arg2) {
    if (!f_Java_org_mozilla_goanna_util_NativeJSObject_getDoubleArray) {
        arg0->ThrowNew(arg0->FindClass("java/lang/UnsupportedOperationException"),
                       "JNI Function called before it was loaded");
        return nullptr;
    }
    return f_Java_org_mozilla_goanna_util_NativeJSObject_getDoubleArray(arg0, arg1, arg2);
}
#endif

#ifdef JNI_BINDINGS
  xul_dlsym("Java_org_mozilla_goanna_util_NativeJSObject_getDoubleArray", &f_Java_org_mozilla_goanna_util_NativeJSObject_getDoubleArray);
#endif

#ifdef JNI_STUBS

typedef jdoubleArray (*Java_org_mozilla_goanna_util_NativeJSObject_optDoubleArray_t)(JNIEnv *, jobject, jstring, jdoubleArray);
static Java_org_mozilla_goanna_util_NativeJSObject_optDoubleArray_t f_Java_org_mozilla_goanna_util_NativeJSObject_optDoubleArray;
extern "C" NS_EXPORT jdoubleArray JNICALL
Java_org_mozilla_goanna_util_NativeJSObject_optDoubleArray(JNIEnv * arg0, jobject arg1, jstring arg2, jdoubleArray arg3) {
    if (!f_Java_org_mozilla_goanna_util_NativeJSObject_optDoubleArray) {
        arg0->ThrowNew(arg0->FindClass("java/lang/UnsupportedOperationException"),
                       "JNI Function called before it was loaded");
        return nullptr;
    }
    return f_Java_org_mozilla_goanna_util_NativeJSObject_optDoubleArray(arg0, arg1, arg2, arg3);
}
#endif

#ifdef JNI_BINDINGS
  xul_dlsym("Java_org_mozilla_goanna_util_NativeJSObject_optDoubleArray", &f_Java_org_mozilla_goanna_util_NativeJSObject_optDoubleArray);
#endif

#ifdef JNI_STUBS

typedef jint (*Java_org_mozilla_goanna_util_NativeJSObject_getInt_t)(JNIEnv *, jobject, jstring);
static Java_org_mozilla_goanna_util_NativeJSObject_getInt_t f_Java_org_mozilla_goanna_util_NativeJSObject_getInt;
extern "C" NS_EXPORT jint JNICALL
Java_org_mozilla_goanna_util_NativeJSObject_getInt(JNIEnv * arg0, jobject arg1, jstring arg2) {
    if (!f_Java_org_mozilla_goanna_util_NativeJSObject_getInt) {
        arg0->ThrowNew(arg0->FindClass("java/lang/UnsupportedOperationException"),
                       "JNI Function called before it was loaded");
        return 0;
    }
    return f_Java_org_mozilla_goanna_util_NativeJSObject_getInt(arg0, arg1, arg2);
}
#endif

#ifdef JNI_BINDINGS
  xul_dlsym("Java_org_mozilla_goanna_util_NativeJSObject_getInt", &f_Java_org_mozilla_goanna_util_NativeJSObject_getInt);
#endif

#ifdef JNI_STUBS

typedef jint (*Java_org_mozilla_goanna_util_NativeJSObject_optInt_t)(JNIEnv *, jobject, jstring, jint);
static Java_org_mozilla_goanna_util_NativeJSObject_optInt_t f_Java_org_mozilla_goanna_util_NativeJSObject_optInt;
extern "C" NS_EXPORT jint JNICALL
Java_org_mozilla_goanna_util_NativeJSObject_optInt(JNIEnv * arg0, jobject arg1, jstring arg2, jint arg3) {
    if (!f_Java_org_mozilla_goanna_util_NativeJSObject_optInt) {
        arg0->ThrowNew(arg0->FindClass("java/lang/UnsupportedOperationException"),
                       "JNI Function called before it was loaded");
        return 0;
    }
    return f_Java_org_mozilla_goanna_util_NativeJSObject_optInt(arg0, arg1, arg2, arg3);
}
#endif

#ifdef JNI_BINDINGS
  xul_dlsym("Java_org_mozilla_goanna_util_NativeJSObject_optInt", &f_Java_org_mozilla_goanna_util_NativeJSObject_optInt);
#endif

#ifdef JNI_STUBS

typedef jintArray (*Java_org_mozilla_goanna_util_NativeJSObject_getIntArray_t)(JNIEnv *, jobject, jstring);
static Java_org_mozilla_goanna_util_NativeJSObject_getIntArray_t f_Java_org_mozilla_goanna_util_NativeJSObject_getIntArray;
extern "C" NS_EXPORT jintArray JNICALL
Java_org_mozilla_goanna_util_NativeJSObject_getIntArray(JNIEnv * arg0, jobject arg1, jstring arg2) {
    if (!f_Java_org_mozilla_goanna_util_NativeJSObject_getIntArray) {
        arg0->ThrowNew(arg0->FindClass("java/lang/UnsupportedOperationException"),
                       "JNI Function called before it was loaded");
        return nullptr;
    }
    return f_Java_org_mozilla_goanna_util_NativeJSObject_getIntArray(arg0, arg1, arg2);
}
#endif

#ifdef JNI_BINDINGS
  xul_dlsym("Java_org_mozilla_goanna_util_NativeJSObject_getIntArray", &f_Java_org_mozilla_goanna_util_NativeJSObject_getIntArray);
#endif

#ifdef JNI_STUBS

typedef jintArray (*Java_org_mozilla_goanna_util_NativeJSObject_optIntArray_t)(JNIEnv *, jobject, jstring, jintArray);
static Java_org_mozilla_goanna_util_NativeJSObject_optIntArray_t f_Java_org_mozilla_goanna_util_NativeJSObject_optIntArray;
extern "C" NS_EXPORT jintArray JNICALL
Java_org_mozilla_goanna_util_NativeJSObject_optIntArray(JNIEnv * arg0, jobject arg1, jstring arg2, jintArray arg3) {
    if (!f_Java_org_mozilla_goanna_util_NativeJSObject_optIntArray) {
        arg0->ThrowNew(arg0->FindClass("java/lang/UnsupportedOperationException"),
                       "JNI Function called before it was loaded");
        return nullptr;
    }
    return f_Java_org_mozilla_goanna_util_NativeJSObject_optIntArray(arg0, arg1, arg2, arg3);
}
#endif

#ifdef JNI_BINDINGS
  xul_dlsym("Java_org_mozilla_goanna_util_NativeJSObject_optIntArray", &f_Java_org_mozilla_goanna_util_NativeJSObject_optIntArray);
#endif

#ifdef JNI_STUBS

typedef jobject (*Java_org_mozilla_goanna_util_NativeJSObject_getObject_t)(JNIEnv *, jobject, jstring);
static Java_org_mozilla_goanna_util_NativeJSObject_getObject_t f_Java_org_mozilla_goanna_util_NativeJSObject_getObject;
extern "C" NS_EXPORT jobject JNICALL
Java_org_mozilla_goanna_util_NativeJSObject_getObject(JNIEnv * arg0, jobject arg1, jstring arg2) {
    if (!f_Java_org_mozilla_goanna_util_NativeJSObject_getObject) {
        arg0->ThrowNew(arg0->FindClass("java/lang/UnsupportedOperationException"),
                       "JNI Function called before it was loaded");
        return nullptr;
    }
    return f_Java_org_mozilla_goanna_util_NativeJSObject_getObject(arg0, arg1, arg2);
}
#endif

#ifdef JNI_BINDINGS
  xul_dlsym("Java_org_mozilla_goanna_util_NativeJSObject_getObject", &f_Java_org_mozilla_goanna_util_NativeJSObject_getObject);
#endif

#ifdef JNI_STUBS

typedef jobject (*Java_org_mozilla_goanna_util_NativeJSObject_optObject_t)(JNIEnv *, jobject, jstring, jobject);
static Java_org_mozilla_goanna_util_NativeJSObject_optObject_t f_Java_org_mozilla_goanna_util_NativeJSObject_optObject;
extern "C" NS_EXPORT jobject JNICALL
Java_org_mozilla_goanna_util_NativeJSObject_optObject(JNIEnv * arg0, jobject arg1, jstring arg2, jobject arg3) {
    if (!f_Java_org_mozilla_goanna_util_NativeJSObject_optObject) {
        arg0->ThrowNew(arg0->FindClass("java/lang/UnsupportedOperationException"),
                       "JNI Function called before it was loaded");
        return nullptr;
    }
    return f_Java_org_mozilla_goanna_util_NativeJSObject_optObject(arg0, arg1, arg2, arg3);
}
#endif

#ifdef JNI_BINDINGS
  xul_dlsym("Java_org_mozilla_goanna_util_NativeJSObject_optObject", &f_Java_org_mozilla_goanna_util_NativeJSObject_optObject);
#endif

#ifdef JNI_STUBS

typedef jobjectArray (*Java_org_mozilla_goanna_util_NativeJSObject_getObjectArray_t)(JNIEnv *, jobject, jstring);
static Java_org_mozilla_goanna_util_NativeJSObject_getObjectArray_t f_Java_org_mozilla_goanna_util_NativeJSObject_getObjectArray;
extern "C" NS_EXPORT jobjectArray JNICALL
Java_org_mozilla_goanna_util_NativeJSObject_getObjectArray(JNIEnv * arg0, jobject arg1, jstring arg2) {
    if (!f_Java_org_mozilla_goanna_util_NativeJSObject_getObjectArray) {
        arg0->ThrowNew(arg0->FindClass("java/lang/UnsupportedOperationException"),
                       "JNI Function called before it was loaded");
        return nullptr;
    }
    return f_Java_org_mozilla_goanna_util_NativeJSObject_getObjectArray(arg0, arg1, arg2);
}
#endif

#ifdef JNI_BINDINGS
  xul_dlsym("Java_org_mozilla_goanna_util_NativeJSObject_getObjectArray", &f_Java_org_mozilla_goanna_util_NativeJSObject_getObjectArray);
#endif

#ifdef JNI_STUBS

typedef jobjectArray (*Java_org_mozilla_goanna_util_NativeJSObject_optObjectArray_t)(JNIEnv *, jobject, jstring, jobjectArray);
static Java_org_mozilla_goanna_util_NativeJSObject_optObjectArray_t f_Java_org_mozilla_goanna_util_NativeJSObject_optObjectArray;
extern "C" NS_EXPORT jobjectArray JNICALL
Java_org_mozilla_goanna_util_NativeJSObject_optObjectArray(JNIEnv * arg0, jobject arg1, jstring arg2, jobjectArray arg3) {
    if (!f_Java_org_mozilla_goanna_util_NativeJSObject_optObjectArray) {
        arg0->ThrowNew(arg0->FindClass("java/lang/UnsupportedOperationException"),
                       "JNI Function called before it was loaded");
        return nullptr;
    }
    return f_Java_org_mozilla_goanna_util_NativeJSObject_optObjectArray(arg0, arg1, arg2, arg3);
}
#endif

#ifdef JNI_BINDINGS
  xul_dlsym("Java_org_mozilla_goanna_util_NativeJSObject_optObjectArray", &f_Java_org_mozilla_goanna_util_NativeJSObject_optObjectArray);
#endif

#ifdef JNI_STUBS

typedef jstring (*Java_org_mozilla_goanna_util_NativeJSObject_getString_t)(JNIEnv *, jobject, jstring);
static Java_org_mozilla_goanna_util_NativeJSObject_getString_t f_Java_org_mozilla_goanna_util_NativeJSObject_getString;
extern "C" NS_EXPORT jstring JNICALL
Java_org_mozilla_goanna_util_NativeJSObject_getString(JNIEnv * arg0, jobject arg1, jstring arg2) {
    if (!f_Java_org_mozilla_goanna_util_NativeJSObject_getString) {
        arg0->ThrowNew(arg0->FindClass("java/lang/UnsupportedOperationException"),
                       "JNI Function called before it was loaded");
        return nullptr;
    }
    return f_Java_org_mozilla_goanna_util_NativeJSObject_getString(arg0, arg1, arg2);
}
#endif

#ifdef JNI_BINDINGS
  xul_dlsym("Java_org_mozilla_goanna_util_NativeJSObject_getString", &f_Java_org_mozilla_goanna_util_NativeJSObject_getString);
#endif

#ifdef JNI_STUBS

typedef jstring (*Java_org_mozilla_goanna_util_NativeJSObject_optString_t)(JNIEnv *, jobject, jstring, jstring);
static Java_org_mozilla_goanna_util_NativeJSObject_optString_t f_Java_org_mozilla_goanna_util_NativeJSObject_optString;
extern "C" NS_EXPORT jstring JNICALL
Java_org_mozilla_goanna_util_NativeJSObject_optString(JNIEnv * arg0, jobject arg1, jstring arg2, jstring arg3) {
    if (!f_Java_org_mozilla_goanna_util_NativeJSObject_optString) {
        arg0->ThrowNew(arg0->FindClass("java/lang/UnsupportedOperationException"),
                       "JNI Function called before it was loaded");
        return nullptr;
    }
    return f_Java_org_mozilla_goanna_util_NativeJSObject_optString(arg0, arg1, arg2, arg3);
}
#endif

#ifdef JNI_BINDINGS
  xul_dlsym("Java_org_mozilla_goanna_util_NativeJSObject_optString", &f_Java_org_mozilla_goanna_util_NativeJSObject_optString);
#endif

#ifdef JNI_STUBS

typedef jobjectArray (*Java_org_mozilla_goanna_util_NativeJSObject_getStringArray_t)(JNIEnv *, jobject, jstring);
static Java_org_mozilla_goanna_util_NativeJSObject_getStringArray_t f_Java_org_mozilla_goanna_util_NativeJSObject_getStringArray;
extern "C" NS_EXPORT jobjectArray JNICALL
Java_org_mozilla_goanna_util_NativeJSObject_getStringArray(JNIEnv * arg0, jobject arg1, jstring arg2) {
    if (!f_Java_org_mozilla_goanna_util_NativeJSObject_getStringArray) {
        arg0->ThrowNew(arg0->FindClass("java/lang/UnsupportedOperationException"),
                       "JNI Function called before it was loaded");
        return nullptr;
    }
    return f_Java_org_mozilla_goanna_util_NativeJSObject_getStringArray(arg0, arg1, arg2);
}
#endif

#ifdef JNI_BINDINGS
  xul_dlsym("Java_org_mozilla_goanna_util_NativeJSObject_getStringArray", &f_Java_org_mozilla_goanna_util_NativeJSObject_getStringArray);
#endif

#ifdef JNI_STUBS

typedef jobjectArray (*Java_org_mozilla_goanna_util_NativeJSObject_optStringArray_t)(JNIEnv *, jobject, jstring, jobjectArray);
static Java_org_mozilla_goanna_util_NativeJSObject_optStringArray_t f_Java_org_mozilla_goanna_util_NativeJSObject_optStringArray;
extern "C" NS_EXPORT jobjectArray JNICALL
Java_org_mozilla_goanna_util_NativeJSObject_optStringArray(JNIEnv * arg0, jobject arg1, jstring arg2, jobjectArray arg3) {
    if (!f_Java_org_mozilla_goanna_util_NativeJSObject_optStringArray) {
        arg0->ThrowNew(arg0->FindClass("java/lang/UnsupportedOperationException"),
                       "JNI Function called before it was loaded");
        return nullptr;
    }
    return f_Java_org_mozilla_goanna_util_NativeJSObject_optStringArray(arg0, arg1, arg2, arg3);
}
#endif

#ifdef JNI_BINDINGS
  xul_dlsym("Java_org_mozilla_goanna_util_NativeJSObject_optStringArray", &f_Java_org_mozilla_goanna_util_NativeJSObject_optStringArray);
#endif

#ifdef JNI_STUBS

typedef jboolean (*Java_org_mozilla_goanna_util_NativeJSObject_has_t)(JNIEnv *, jobject, jstring);
static Java_org_mozilla_goanna_util_NativeJSObject_has_t f_Java_org_mozilla_goanna_util_NativeJSObject_has;
extern "C" NS_EXPORT jboolean JNICALL
Java_org_mozilla_goanna_util_NativeJSObject_has(JNIEnv * arg0, jobject arg1, jstring arg2) {
    if (!f_Java_org_mozilla_goanna_util_NativeJSObject_has) {
        arg0->ThrowNew(arg0->FindClass("java/lang/UnsupportedOperationException"),
                       "JNI Function called before it was loaded");
        return false;
    }
    return f_Java_org_mozilla_goanna_util_NativeJSObject_has(arg0, arg1, arg2);
}
#endif

#ifdef JNI_BINDINGS
  xul_dlsym("Java_org_mozilla_goanna_util_NativeJSObject_has", &f_Java_org_mozilla_goanna_util_NativeJSObject_has);
#endif

#ifdef JNI_STUBS

typedef jobject (*Java_org_mozilla_goanna_util_NativeJSObject_toBundle_t)(JNIEnv *, jobject);
static Java_org_mozilla_goanna_util_NativeJSObject_toBundle_t f_Java_org_mozilla_goanna_util_NativeJSObject_toBundle;
extern "C" NS_EXPORT jobject JNICALL
Java_org_mozilla_goanna_util_NativeJSObject_toBundle(JNIEnv * arg0, jobject arg1) {
    if (!f_Java_org_mozilla_goanna_util_NativeJSObject_toBundle) {
        arg0->ThrowNew(arg0->FindClass("java/lang/UnsupportedOperationException"),
                       "JNI Function called before it was loaded");
        return nullptr;
    }
    return f_Java_org_mozilla_goanna_util_NativeJSObject_toBundle(arg0, arg1);
}
#endif

#ifdef JNI_BINDINGS
  xul_dlsym("Java_org_mozilla_goanna_util_NativeJSObject_toBundle", &f_Java_org_mozilla_goanna_util_NativeJSObject_toBundle);
#endif

#ifdef JNI_STUBS

typedef jstring (*Java_org_mozilla_goanna_util_NativeJSObject_toString_t)(JNIEnv *, jobject);
static Java_org_mozilla_goanna_util_NativeJSObject_toString_t f_Java_org_mozilla_goanna_util_NativeJSObject_toString;
extern "C" NS_EXPORT jstring JNICALL
Java_org_mozilla_goanna_util_NativeJSObject_toString(JNIEnv * arg0, jobject arg1) {
    if (!f_Java_org_mozilla_goanna_util_NativeJSObject_toString) {
        arg0->ThrowNew(arg0->FindClass("java/lang/UnsupportedOperationException"),
                       "JNI Function called before it was loaded");
        return nullptr;
    }
    return f_Java_org_mozilla_goanna_util_NativeJSObject_toString(arg0, arg1);
}
#endif

#ifdef JNI_BINDINGS
  xul_dlsym("Java_org_mozilla_goanna_util_NativeJSObject_toString", &f_Java_org_mozilla_goanna_util_NativeJSObject_toString);
#endif

